## conf/layer.conf
```bitbake
# We have a conf and classes directory, add to BBPATH
BBPATH .= ":${LAYERDIR}"

# We have recipes-* directories, add to BBFILES
BBFILES += "${LAYERDIR}/recipes-*/*/*.bb \
            ${LAYERDIR}/recipes-*/*/*.bbappend"

BBFILE_COLLECTIONS += "meta-ingersoll"
BBFILE_PATTERN_meta-ingersoll = "^${LAYERDIR}/"
BBFILE_PRIORITY_meta-ingersoll = "6"

LAYERDEPENDS_meta-ingersoll = "core"
LAYERSERIES_COMPAT_meta-ingersoll = "kirkstone"
```
